## config/boards/shields/cool942tb/Kconfig.shield
```kconfig
config SHIELD_COOL942TB_R
    def_bool $(shields_list_contains,cool942tb_R)

config SHIELD_COOL942TB_L
    def_bool $(shields_list_contains,cool942tb_L)
```

## config/west.yml
```yaml
manifest:
  remotes:
    - name: zmkfirmware
      url-base: https://github.com/zmkfirmware
    - name: telzo2000-git
      url-base: https://github.com/telzo2000-git
  projects:
    - name: zmk
      remote: zmkfirmware
      revision: main
      import: app/west.yml
    - name: zmk-pmw3610-driver
      remote: telzo2000-git
      revision: main
  self:
    path: config
```
